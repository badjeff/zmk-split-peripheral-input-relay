## Kconfig
```kconfig
# Sensor data simulator
#
# Copyright (c) 2019 Nordic Semiconductor
#
# SPDX-License-Identifier: LicenseRef-Nordic-5-Clause
#

DT_COMPAT_ZMK_SPLT_PERIPHERAL_INPUT_RELAY := zmk,split-peripheral-input-relay
config ZMK_SPLT_PERIPHERAL_INPUT_RELAY
		bool
		default $(dt_compat_enabled,$(DT_COMPAT_ZMK_SPLT_PERIPHERAL_INPUT_RELAY))

DT_COMPAT_ZMK_VIRTUAL_INPUT := zmk,virtual-input
config ZMK_VIRTUAL_INPUT
		bool
		default $(dt_compat_enabled,$(DT_COMPAT_ZMK_VIRTUAL_INPUT))
```

## dts/bindings/zmk,split-peripheral-input-relay.yaml
```yaml
# Copyright (c) 2024 The ZMK Contributors
# SPDX-License-Identifier: MIT

description: |
  Allows defining input relay channels

compatible: "zmk,split-peripheral-input-relay"

properties:
  relay-channel:
    type: int
    required: true
  device:
    type: phandle
    required: true
```

## dts/bindings/zmk,virtual-input.yaml
```yaml
# Copyright (c) 2024 The ZMK Contributors
# SPDX-License-Identifier: MIT

description: |
   Dummy device as an dummy input event emitter.

compatible: "zmk,virtual-input"
```
